/*
 * Copyright (C) 2015 PHYTEC America, LLC
 *
 * This program is free software; you can redistribute it and/or modify
 * it under the terms of the GNU General Public License version 2 as
 * published by the Free Software Foundation.
 *
 *
 * DTS for PHYTEC kit KPB-01910-001
 *
 * Minimal base for compatible images
 */
/dts-v1/;

#include "imx7d.dtsi"			/* Dual Processor */
#include "imx7-phycore-som.dtsi"	/* Superset - includes all SOM population options */
#include "imx7d-pba-c-09.dtsi"		/* Carrier board with support for Dual processor */


#include "imx7d-pcm-061-2110111c.dtsi"	/* SOM variant */

/* RTC is now used for U-Boot boot counter */
&i2c_rtc {
	status = "disabled";
};

/* No PCIe used */
&pcie {
        status = "disabled";
};

&pcie_phy {
        status = "disabled";
};



