/*
 * Copyright (C) 2017 PHYTEC America, LLC
 *
 * This program is free software; you can redistribute it and/or modify
 * it under the terms of the GNU General Public License version 2 as
 * published by the Free Software Foundation.
 *
 *
 * DTS for PHYTEC kit KPB-01910-002
 */

/dts-v1/;

#include "imx7-phycore-som.dtsi"	/* Superset - includes all SOM population options */
#include "imx7-pba-c-09.dtsi"		/* Carrier board */
#include "imx7-peb-eval-02.dtsi"	/* Evaluation module */

#include "imx7s-pcm-061-0502100e.dtsi"	/* SOM variant */
