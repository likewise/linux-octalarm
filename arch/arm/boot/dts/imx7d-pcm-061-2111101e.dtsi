/*
 * Copyright (C) 2017 PHYTEC America, LLC
 *
 * This program is free software; you can redistribute it and/or modify
 * it under the terms of the GNU General Public License version 2 as
 * published by the Free Software Foundation.
 *
 * i.MX7 Processor MCIMX7D3EVK10SC
 *
 */

/ {
	model = "Phytec phyCORE-i.MX7 Dual, Extended Temp";
	compatible = "phytec,mx7d-pcm-061-2111101e", "phytec,imx7-phycore-som", "fsl,imx7d";
};

/* No CAN on MCIMX7D3EVK10SC */
&flexcan1 {
	status = "disabled";
};

&flexcan2 {
	status = "disabled";
};

/* ETH0 PHY not populated */
&ethphy0 {
	status = "disabled";
};
