/*
 * Copyright (C) 2017 PHYTEC America, LLC
 *
 * This program is free software; you can redistribute it and/or modify
 * it under the terms of the GNU General Public License version 2 as
 * published by the Free Software Foundation.
 */
&reg_wlan {
	startup-delay-us = <100>;
	enable-active-high;
	regulator-min-microvolt = <1800000>;
	regulator-max-microvolt = <1800000>;
	regulator-always-on;
	status = "okay";
};

&reg_bt {
	startup-delay-us = <100>;
	enable-active-high;
	regulator-min-microvolt = <1800000>;
	regulator-max-microvolt = <1800000>;
	regulator-always-on;
	status = "okay";
};

&usdhc2 {
	bus-width = <4>;
	non-removable;
	status = "okay";
};

&uart7 {
	fsl,uart-has-rtscts;
	fsl,dte-mode;
	status = "okay";
};
