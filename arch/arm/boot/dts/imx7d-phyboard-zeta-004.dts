/*
 * Copyright (C) 2018 PHYTEC America, LLC
 *
 * This program is free software; you can redistribute it and/or modify
 * it under the terms of the GNU General Public License version 2 as
 * published by the Free Software Foundation.
 *
 *
 * DTS for PHYTEC kit KPB-01910-004
 */
/dts-v1/;

#include "imx7d.dtsi"			/* Dual Processor */
#include "imx7-phycore-som.dtsi"	/* Superset - includes all SOM population options */
#include "imx7d-pba-c-09.dtsi"		/* Carrier board */
#include "imx7-peb-av-02.dtsi"		/* LCD adapter */
#include "imx7-peb-d-rpi.dtsi"		/* PEB-D-RPI module */

#include "imx7d-pcm-061-2110111c.dtsi"	/* SOM variant */
