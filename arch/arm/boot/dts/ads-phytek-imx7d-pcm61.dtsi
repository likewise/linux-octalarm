/*
 * Copyright (C) 2018 Adesys
 *
 * This program is free software; you can redistribute it and/or modify
 * it under the terms of the GNU General Public License version 2 as
 * published by the Free Software Foundation.
 *
 *
 * DTS for the Adesys variant of the Phytek PCM-061 imx7d module
 *
 */
/dts-v1/;

#include "imx7d.dtsi"			/* Dual Processor */
#include "imx7-phycore-som.dtsi"	/* Superset - includes all SOM population options */
#include "imx7d-pcm-061-2110111c.dtsi"	/* SOM variant */

/* RTC is now used for U-Boot boot counter */
&i2c_rtc {
	status = "disabled";
};

/* Set tuning step to 1 fix tuning errors with emmc boot */
&usdhc3 {
	tuning-step = <1>;
};
