/*
 * Copyright (C) 2015 PHYTEC America, LLC
 *
 * This program is free software; you can redistribute it and/or modify
 * it under the terms of the GNU General Public License version 2 as
 * published by the Free Software Foundation.
 *
 *
 * DTS for PHYTEC kit KPB-01910-001
 *
 * Development kit with official touchscreen
 */
/dts-v1/;

#include "imx7d-octalarm-0.dts"			/* Dual Processor */
#include "imx7-peb-av-02.dtsi"		/* LCD adapter */

&display0 {
	display-timings {
                native-mode = <&timing1>;
                timing1: ETM0700G0DH6 {
                        clock-frequency = <33000000>;
                        hactive = <800>;
                        vactive = <480>;
                        hfront-porch = <40>;
                        hback-porch = <216>;
                        hsync-len = <128>;
                        vback-porch = <35>;
                        vfront-porch = <10>;
                        vsync-len = <2>;
                        hsync-active = <0>;
                        vsync-active = <0>;
                        de-active = <1>;
                        pixelclk-active = <1>;
                };
        };
};

&backlight {
	pwms = <&pwm3 0 5000000 0>;
};

